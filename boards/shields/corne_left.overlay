&i2c1 {
    status = "okay";
    oled: ssd1306@3c {
        compatible = "solomon,ssd1306fb";
        reg = <0x3c>;
        width = <128>;
        height = <32>;
        segment-offset = <0>;
        page-offset = <0>;
        display-offset = <0>;
        multiplex-ratio = <31>;
        reset-gpios = <&gpio0 7 GPIO_ACTIVE_LOW>; // Adjust pin as needed
    };
};
