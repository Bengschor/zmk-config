&i2c1 {
    status = "okay";
    niceview: ssd1306@3c {
        compatible = "solomon,ssd1306fb";
        reg = <0x3c>;
        width = <128>;
        height = <32>;
        // Other required properties
    };
};
